## conf/distro/openvision.conf
```bitbake
#@TYPE: Distribution
#@NAME: OpenVision
#@DESCRIPTION: Embedded Linux Distribution Configuration for STB's

require openvision-common.conf
require stb-hardware.conf

VIRTUAL-RUNTIME_dev_manager = "busybox-mdev"
VIRTUAL-RUNTIME_login_manager = "busybox"
VIRTUAL-RUNTIME_init_manager = "sysvinit"
VIRTUAL-RUNTIME_initscripts = "initscripts"

MACHINE_KERNEL_PR_append = "openvision"
```
