## conf/distro/stb-hardware.conf
```bitbake
DISPLAY_TYPE = "\
${@bb.utils.contains("MACHINE_FEATURES", "textlcd", "textlcd" , "", d)} \
${@bb.utils.contains_any("MACHINE_FEATURES", "7segment 7seg", "7segment" , "", d)} \
${@bb.utils.contains("MACHINE_FEATURES", "bwlcd96", "bwlcd96" , "", d)} \
${@bb.utils.contains("MACHINE_FEATURES", "bwlcd128", "bwlcd128" , "", d)} \
${@bb.utils.contains("MACHINE_FEATURES", "bwlcd140", "bwlcd140" , "", d)} \
${@bb.utils.contains("MACHINE_FEATURES", "bwlcd255", "bwlcd255" , "", d)} \
${@bb.utils.contains("MACHINE_FEATURES", "colorlcd128", "colorlcd128" , "", d)} \
${@bb.utils.contains("MACHINE_FEATURES", "colorlcd220", "colorlcd220" , "", d)} \
${@bb.utils.contains("MACHINE_FEATURES", "colorlcd390", "colorlcd390" , "", d)} \
${@bb.utils.contains("MACHINE_FEATURES", "colorlcd400", "colorlcd400" , "", d)} \
${@bb.utils.contains("MACHINE_FEATURES", "colorlcd480", "colorlcd480" , "", d)} \
${@bb.utils.contains("MACHINE_FEATURES", "colorlcd720", "colorlcd720" , "", d)} \
${@bb.utils.contains("MACHINE_FEATURES", "colorlcd800", "colorlcd800" , "", d)} \
"

TRANSCODING = "${@bb.utils.contains("MACHINE_FEATURES", "transcoding", "transcoding" , "", d)}"

MULTITRANSCODING = "${@bb.utils.contains("MACHINE_FEATURES", "multitranscoding", "multitranscoding" , "", d)}"

HAVE_SMALLFLASH = "${@bb.utils.contains("MACHINE_FEATURES", "smallflash", "True" , "False", d)}"

HAVE_MIDDLEFLASH = "${@bb.utils.contains("MACHINE_FEATURES", "middleflash", "True" , "False", d)}"

HAVE_MULTILIB = "${@bb.utils.contains("MACHINE_FEATURES", "multilib", "True" , "False", d)}"
```

## conf/layer.conf
```bitbake
# We have a conf and classes directory, append to BBPATH
BBPATH .= ":${LAYERDIR}"

# We have a recipes directory, add to BBFILES
BBFILES += "${LAYERDIR}/recipes-*/*.bb ${LAYERDIR}/recipes-*/*.bbappend \
            ${LAYERDIR}/recipes-*/*/*.bb ${LAYERDIR}/recipes-*/*/*.bbappend \
            ${LAYERDIR}/recipes-*/*/*/*.bb ${LAYERDIR}/recipes-*/*/*/*.bbappend"

BBFILE_COLLECTIONS += "openvision-oe-layer"
BBFILE_PATTERN_openvision-oe-layer := "^${LAYERDIR}/"
BBFILE_PRIORITY_openvision-oe-layer = "8"

WARN_QA_remove = "ldflags build-deps already-stripped installed-vs-shipped textrel incompatible-license staticdev src-uri-bad patch-fuzz"
ERROR_QA_remove = "license-checksum file-rdeps dev-so debug-deps dev-deps debug-files"

MIRRORS += "\
ftp://.*/.*    http://openvix.co.uk/feeds_extras/sources-mirror/ \n \
http://.*/.*   http://openvix.co.uk/feeds_extras/sources-mirror/ \n \
https://.*/.*  http://openvix.co.uk/feeds_extras/sources-mirror/ \n \
ftp://.*/.*    http://source.mynonpublic.com/ \n \
http://.*/.*   http://source.mynonpublic.com/ \n \
https://.*/.*  http://source.mynonpublic.com/ \n \
ftp://.*/.*    http://archive.vuplus.com/openvuplus_mirror/ \n \
http://.*/.*   http://archive.vuplus.com/openvuplus_mirror/ \n \
https://.*/.*  http://archive.vuplus.com/openvuplus_mirror/ \n \
ftp://.*/.*    http://autobuilder.yoctoproject.org/sources/ \n \
http://.*/.*   http://autobuilder.yoctoproject.org/sources/ \n \
https://.*/.*  http://autobuilder.yoctoproject.org/sources/ \n \
"

PREMIRRORS ?= "\
bzr://.*/.*   http://openvix.co.uk/feeds_extras/sources-mirror/ \n \
cvs://.*/.*   http://openvix.co.uk/feeds_extras/sources-mirror/ \n \
git://.*/.*   http://openvix.co.uk/feeds_extras/sources-mirror/ \n \
hg://.*/.*    http://openvix.co.uk/feeds_extras/sources-mirror/ \n \
osc://.*/.*   http://openvix.co.uk/feeds_extras/sources-mirror/ \n \
p4://.*/.*    http://openvix.co.uk/feeds_extras/sources-mirror/ \n \
svn://.*/.*   http://openvix.co.uk/feeds_extras/sources-mirror/ \n \
bzr://.*/.*   http://source.mynonpublic.com/ \n \
cvs://.*/.*   http://source.mynonpublic.com/ \n \
git://.*/.*   http://source.mynonpublic.com/ \n \
hg://.*/.*    http://source.mynonpublic.com/ \n \
osc://.*/.*   http://source.mynonpublic.com/ \n \
p4://.*/.*    http://source.mynonpublic.com/ \n \
svn://.*/.*   http://source.mynonpublic.com/ \n \
bzr://.*/.*   http://archive.vuplus.com/openvuplus_mirror/ \n \
cvs://.*/.*   http://archive.vuplus.com/openvuplus_mirror/ \n \
git://.*/.*   http://archive.vuplus.com/openvuplus_mirror/ \n \
hg://.*/.*    http://archive.vuplus.com/openvuplus_mirror/ \n \
osc://.*/.*   http://archive.vuplus.com/openvuplus_mirror/ \n \
p4://.*/.*    http://archive.vuplus.com/openvuplus_mirror/ \n \
svn://.*/.*   http://archive.vuplus.com/openvuplus_mirror/ \n \
bzr://.*/.*   http://autobuilder.yoctoproject.org/sources/ \n \
cvs://.*/.*   http://autobuilder.yoctoproject.org/sources/ \n \
git://.*/.*   http://autobuilder.yoctoproject.org/sources/ \n \
hg://.*/.*    http://autobuilder.yoctoproject.org/sources/ \n \
osc://.*/.*   http://autobuilder.yoctoproject.org/sources/ \n \
p4://.*/.*    http://autobuilder.yoctoproject.org/sources/ \n \
svn://.*/.*   http://autobuilder.yoctoproject.org/sources/ \n \
"
```

## meta-openvision/conf/distro/openvision-common.conf
```bitbake
#@TYPE: Distribution
#@NAME: OpenVision
#@DESCRIPTION: Embedded Linux Distribution Configuration for STB's

require reporefs.conf
require revision.conf
require preferred-provider-version.conf
require openvision-testers.conf

DISTRO_FEATURES_BACKFILL_CONSIDERED += "pulseaudio gobject-introspection-data"

BB_HASH_IGNORE_MISMATCH = "1"

DISTRO_NAME = "openvision"
DISTRO_HOST ?= "${@os.uname()[1]}"
DISTRO_VERSION = "develop"
DISTRO_TYPE = "release"
BUILD_VERSION = "pyro"
DEVELOPER_BUILD_VERSION = "old"
VISIONGCCVERSION = "6"
VISIONVERSION = "7.5"

PYTHONPATHVERSION = "python2.7"
PYTHONEXACTVERSION = "python2"

MACHINE_FEATURES += "${@bb.utils.contains("TARGET_ARCH", "mipsel", "middleflash", "", d)}"

LANGUAGECHECK = "${@bb.utils.contains("MACHINE_FEATURES", "middleflash", "multilanguage", "extralanguage", d)}"
VISIONLANGUAGE = "${@bb.utils.contains("MACHINE_FEATURES", "smallflash", "english", "${LANGUAGECHECK}", d)}"

MAINTAINER ?= "Open Vision developers <forum.openvision.tech>"

MACHINE_KERNEL_PR_append = "openvision"

MACHINETYPE ?= "${MACHINE}"
STB_PLATFORM ?= "${MACHINE}"
IMAGEDIR ??= "${MACHINE}"

IMGDEPLOYDIR ?= "${DEPLOY_DIR_IMAGE}"

IMAGEDIRRECOVERY ?= "${MACHINE}-recovery"

BLINDSCAN_BINARY ?= "blindscan"

KV ?= "${KERNELVERSION}"

FORCE ?= "no"

UBI_VOLNAME ?= "rootfs"

RCTYPE ??= "0"
RCNAME ??= "dmm1"
RCIDNUM ??= "2"

BUILDCFG_VARS += "VISIONVERSION VISIONREVISION VISIONLANGUAGE BOX_BRAND STB_PLATFORM SOC_FAMILY KERNELVERSION HAVE_MULTILIB HAVE_MIDDLEFLASH HAVE_SMALLFLASH ${@bb.utils.contains_any("MACHINE_FEATURES", "7segment 7seg textlcd bwlcd96 bwlcd128 bwlcd140 bwlcd255 colorlcd128 colorlcd220 colorlcd390 colorlcd400 colorlcd480 colorlcd720 colorlcd800", "DISPLAY_TYPE" , "", d)} RCTYPE RCNAME DEVELOPER_NAME DISTRO_FEED_URI"

INHERIT += "extrausers"
EXTRA_USERS_PARAMS = "usermod -P openvision root;"

IPKG_VARIANT = "opkg"
PACKAGE_DEBUG_SPLIT_STYLE = "debug-without-src"

FEED_NAME ?= "${DISTRO_NAME}-${DISTRO_VERSION}"
DISTRO_FEED_URI ?= "http://${DISTRO_HOST}/feeds/${FEED_NAME}"
DISTRO_FEED_PREFIX ?= "${DISTRO_NAME}"

IMAGE_NAME = "${IMAGE_BASENAME}-${DISTRO_VERSION}-${VISIONLANGUAGE}-${PYTHONEXACTVERSION}-${VISIONVERSION}-${VISIONREVISION}-${MACHINE}"
IMAGE_NAME[vardepsexclude] += "DATE"
IMAGE_LINK_NAME = ""
CACHE ?= "${TMPDIR}/cache/${LIBC}/${MACHINE}"
DEPLOY_DIR ?= "${TMPDIR}/deploy/${LIBC}"
DEPLOY_DIR_IMAGE ?= "${DEPLOY_DIR}/images/${MACHINE}"

LICENSE_FLAGS_WHITELIST = "commercial"
COMMERCIAL_AUDIO_PLUGINS ?= "gst-plugins-ugly-mad gst-plugins-ugly-mpegaudioparse"
COMMERCIAL_VIDEO_PLUGINS ?= "gst-plugins-ugly-mpeg2dec gst-plugins-ugly-mpegstream gst-plugins-bad-mpegvideoparse"

# OE optimization defaults to -O2 which makes for much larger binaries.
# Override here to use -Os instead, resulting in smaller images.
FULL_OPTIMIZATION = "-Os -Wno-error -pipe ${DEBUG_FLAGS}"
O2_OPT = "${@bb.utils.contains("MACHINE_FEATURES", "smallflash", "-Os -Wno-error -pipe ${DEBUG_FLAGS}", "-O2 -pipe ${DEBUG_FLAGS}", d)}"
O3_OPT = "${@bb.utils.contains("MACHINE_FEATURES", "smallflash", "-Os -Wno-error -pipe ${DEBUG_FLAGS}", "-O3 -pipe ${DEBUG_FLAGS}", d)}"
# build some core libs with better compiler optimization for better performance
FULL_OPTIMIZATION_pn-flac = "${O3_OPT}"
FULL_OPTIMIZATION_pn-jpeg = "${O3_OPT}"
FULL_OPTIMIZATION_pn-lame = "${O3_OPT}"
FULL_OPTIMIZATION_pn-liba52 = "${O3_OPT}"
FULL_OPTIMIZATION_pn-libdca = "${O3_OPT}"
FULL_OPTIMIZATION_pn-libgcrypt = "${O3_OPT}"
FULL_OPTIMIZATION_pn-libmad = "${O3_OPT}"
FULL_OPTIMIZATION_pn-libogg = "${O3_OPT}"
FULL_OPTIMIZATION_pn-libpng = "${O3_OPT}"
FULL_OPTIMIZATION_pn-libsamplerate = "${O3_OPT}"
FULL_OPTIMIZATION_pn-libvorbis = "${O3_OPT}"
FULL_OPTIMIZATION_pn-tremor = "${O3_OPT}"
FULL_OPTIMIZATION_pn-zlib = "${O3_OPT}"
FULL_OPTIMIZATION_pn-dhrystone = "-O3 -Ofast -DNDEBUG -DTIME"

DISTRO_FEATURES += "bluez5 alsa bluetooth directfb ext2 ipv4 ipv6 largefile wifi nfs zeroconf pam ${DISTRO_FEATURES_LIBC} openvision7"

QA_LOGFILE = "${TMPDIR}/qa.log"

OEINCLUDELOGS ?= "yes"
KERNEL_CONSOLE ?= "ttyS0,115200n8"

BB_GENERATE_MIRROR_TARBALLS ??= "1"

NO32LIBS ??= "1"

# Missing checksums should raise an error
BB_STRICT_CHECKSUM = "0"

# Place output in "tmp" as before, not "tmp-glibc"
TCLIBCAPPEND = ""

# Don't grab feeds for lower level archs, e.g. mips32el should not
# attempt to fetch mipsel, and armv7 need not fetch armv5 etcetera.
DISTRO_FEED_ARCHS = "all ${TUNE_PKGARCH} ${MACHINE_ARCH} ${OEM_ARCH}"

# Use OpenSSL only
PACKAGECONFIG_pn-curl = "ipv6 ssl proxy zlib libssh2"
PACKAGECONFIG_pn-openldap = "openssl modules mdb ldap meta monitor null passwd shell proxycache dnssrv ipv6"
PACKAGECONFIG_pn-neon = "expat openssl libproxy webdav zlib"

HOSTTOOLS += "git-lfs java svn unzip msgfmt zip"

VIRTUAL-RUNTIME_base-utils-hwclock = " "

FETCHCOMMAND_wget = "/usr/bin/env wget -T 10 -t 5 -nv --passive-ftp --no-check-certificate -P ${DL_DIR} '${URI}'"
```

## meta-openvision/conf/distro/openvision-image.conf
```bitbake
DISTRO_NAME = "openvision"
DISTRO_HOST ?= "${@os.uname()[1]}"
DISTRO_VERSION = "develop"
DISTRO_TYPE = "release"
BUILD_VERSION = "pyro"
DEVELOPER_BUILD_VERSION = "old"
VISIONGCCVERSION = "6"
VISIONVERSION = "7.5"

MACHINE_FEATURES += "${@bb.utils.contains("TARGET_ARCH", "mipsel", "middleflash", "", d)}"

LANGUAGECHECK = "${@bb.utils.contains("MACHINE_FEATURES", "middleflash", "multilanguage", "extralanguage", d)}"
VISIONLANGUAGE = "${@bb.utils.contains("MACHINE_FEATURES", "smallflash", "english", "${LANGUAGECHECK}", d)}"

MAINTAINER ?= "Open Vision developers <forum.openvision.tech>"

MACHINE_KERNEL_PR_append = "openvision"

MACHINETYPE ?= "${MACHINE}"
STB_PLATFORM ?= "${MACHINE}"
IMAGEDIR ??= "${MACHINE}"

IMGDEPLOYDIR ?= "${DEPLOY_DIR_IMAGE}"

IMAGEDIRRECOVERY ?= "${MACHINE}-recovery"

BLINDSCAN_BINARY ?= "blindscan"

KV ?= "${KERNELVERSION}"

FORCE ?= "no"

UBI_VOLNAME ?= "rootfs"

RCTYPE ??= "0"
RCNAME ??= "dmm1"
RCIDNUM ??= "2"

INHERIT += "extrausers"
EXTRA_USERS_PARAMS = "usermod -P openvision root;"

FEED_NAME ?= "${DISTRO_NAME}-${DISTRO_VERSION}"
DISTRO_FEED_URI ?= "http://${DISTRO_HOST}/feeds/${FEED_NAME}"
DISTRO_FEED_PREFIX ?= "${DISTRO_NAME}"

IMAGE_NAME = "${IMAGE_BASENAME}-${DISTRO_VERSION}-${VISIONLANGUAGE}-${PYTHONEXACTVERSION}-${VISIONVERSION}-${VISIONREVISION}-${MACHINE}"
IMAGE_NAME[vardepsexclude] += "DATE"
IMAGE_LINK_NAME = ""
CACHE ?= "${TMPDIR}/cache/${LIBC}/${MACHINE}"
DEPLOY_DIR ?= "${TMPDIR}/deploy/${LIBC}"
DEPLOY_DIR_IMAGE ?= "${DEPLOY_DIR}/images/${MACHINE}"

KERNEL_MODULE_AUTOLOAD += "\
	ipv6 \
	openvision \
	"
```

## meta-openvision/conf/distro/openvision-systemd.conf
```bitbake
#@TYPE: Distribution
#@NAME: OpenVision
#@DESCRIPTION: Embedded Linux Distribution Configuration for STB's

require openvision-common.conf

DISTRO_VERSION = "home-systemd"

DISTRO_FEATURES_INITMAN = "systemd"
VIRTUAL-RUNTIME_init_manager = "${DISTRO_FEATURES_INITMAN}"
DISTRO_FEATURES += "systemd"
```

## meta-openvision/conf/layer.conf
```bitbake
# We have a conf and classes directory, append to BBPATH
BBPATH .= ":${LAYERDIR}"

# We have a recipes directory, add to BBFILES
BBFILES += "${LAYERDIR}/recipes-*/*.bb ${LAYERDIR}/recipes-*/*.bbappend \
            ${LAYERDIR}/recipes-*/*/*.bb ${LAYERDIR}/recipes-*/*/*.bbappend \
            ${LAYERDIR}/recipes-*/*/*/*.bb ${LAYERDIR}/recipes-*/*/*/*.bbappend"

BBFILE_COLLECTIONS += "meta-openvision-layer"
BBFILE_PATTERN_meta-openvision-layer := "^${LAYERDIR}/"
BBFILE_PRIORITY_meta-openvision-layer = "8"

OPENVISION_BASE := '${@os.path.normpath("${LAYERDIR}/../")}'
# Prevent current directory creeping into sstate objects. Otherwise, building
# in another TOPDIR will cause recipes using this variable to be rebuilt.
OPENVISION_BASE[vardepvalue] = 'meta-openvision'

LICENSE_PATH += "${LAYERDIR}/licenses"

DEFAULT_TIMEZONE ?= "GMT"

# This prevents bitbake to fail at do_package caused by default OE-core split style variable setting
PACKAGE_DEBUG_SPLIT_STYLE = "debug-without-src"

WARN_QA_remove += "ldflags build-deps already-stripped textrel incompatible-license staticdev installed-vs-shipped unknown-configure-option"
ERROR_QA_remove += "license-checksum file-rdeps dev-so debug-deps dev-deps debug-files"

MIRRORS += "\
ftp://.*/.*    http://openvix.co.uk/feeds_extras/sources-mirror/ \n \
http://.*/.*   http://openvix.co.uk/feeds_extras/sources-mirror/ \n \
https://.*/.*  http://openvix.co.uk/feeds_extras/sources-mirror/ \n \
ftp://.*/.*    http://source.mynonpublic.com/ \n \
http://.*/.*   http://source.mynonpublic.com/ \n \
https://.*/.*  http://source.mynonpublic.com/ \n \
ftp://.*/.*    http://archive.vuplus.com/openvuplus_mirror/ \n \
http://.*/.*   http://archive.vuplus.com/openvuplus_mirror/ \n \
https://.*/.*  http://archive.vuplus.com/openvuplus_mirror/ \n \
ftp://.*/.*    http://autobuilder.yoctoproject.org/sources/ \n \
http://.*/.*   http://autobuilder.yoctoproject.org/sources/ \n \
https://.*/.*  http://autobuilder.yoctoproject.org/sources/ \n \
"

PREMIRRORS ?= "\
bzr://.*/.*   http://openvix.co.uk/feeds_extras/sources-mirror/ \n \
cvs://.*/.*   http://openvix.co.uk/feeds_extras/sources-mirror/ \n \
git://.*/.*   http://openvix.co.uk/feeds_extras/sources-mirror/ \n \
hg://.*/.*    http://openvix.co.uk/feeds_extras/sources-mirror/ \n \
osc://.*/.*   http://openvix.co.uk/feeds_extras/sources-mirror/ \n \
p4://.*/.*    http://openvix.co.uk/feeds_extras/sources-mirror/ \n \
svn://.*/.*   http://openvix.co.uk/feeds_extras/sources-mirror/ \n \
bzr://.*/.*   http://source.mynonpublic.com/ \n \
cvs://.*/.*   http://source.mynonpublic.com/ \n \
git://.*/.*   http://source.mynonpublic.com/ \n \
hg://.*/.*    http://source.mynonpublic.com/ \n \
osc://.*/.*   http://source.mynonpublic.com/ \n \
p4://.*/.*    http://source.mynonpublic.com/ \n \
svn://.*/.*   http://source.mynonpublic.com/ \n \
bzr://.*/.*   http://archive.vuplus.com/openvuplus_mirror/ \n \
cvs://.*/.*   http://archive.vuplus.com/openvuplus_mirror/ \n \
git://.*/.*   http://archive.vuplus.com/openvuplus_mirror/ \n \
hg://.*/.*    http://archive.vuplus.com/openvuplus_mirror/ \n \
osc://.*/.*   http://archive.vuplus.com/openvuplus_mirror/ \n \
p4://.*/.*    http://archive.vuplus.com/openvuplus_mirror/ \n \
svn://.*/.*   http://archive.vuplus.com/openvuplus_mirror/ \n \
bzr://.*/.*   http://autobuilder.yoctoproject.org/sources/ \n \
cvs://.*/.*   http://autobuilder.yoctoproject.org/sources/ \n \
git://.*/.*   http://autobuilder.yoctoproject.org/sources/ \n \
hg://.*/.*    http://autobuilder.yoctoproject.org/sources/ \n \
osc://.*/.*   http://autobuilder.yoctoproject.org/sources/ \n \
p4://.*/.*    http://autobuilder.yoctoproject.org/sources/ \n \
svn://.*/.*   http://autobuilder.yoctoproject.org/sources/ \n \
"
```
