## conf/distro/preferred-provider-version.conf
```bitbake
# python
PYTHON_BASEVERSION = "2.7"
PREFERRED_VERSION_python = "2.7.13"
PREFERRED_VERSION_python-native = "2.7.13"

# wlan
PREFERRED_VERSION_rtl8192cu ?= "4.0.2"

# samba
PREFERRED_VERSION_samba = "4.%"

# libs
PREFERRED_VERSION_libnl ?= "3.2.29"
PREFERRED_PROVIDER_libfribidi = "libfribidi"
PREFERRED_PROVIDER_openssl = "openssl10"
PREFERRED_PROVIDER_libcrypto = "openssl10"
PREFERRED_PROVIDER_libssl = "openssl10"
PREFERRED_PROVIDER_openssl-native = "openssl10-native"
PREFERRED_PROVIDER_libcrypto-native = "openssl10-native"
PREFERRED_PROVIDER_libssl-native = "openssl10-native"

# enigma2 and binaries
PREFERRED_PROVIDER_virtual/enigma2-mediaservice ?= "enigma2-plugin-systemplugins-servicemp3"

# gcc
PREFERRED_PROVIDERS += "virtual/${TARGET_PREFIX}gcc-initial:gcc-cross-initial"
PREFERRED_PROVIDERS += "virtual/${TARGET_PREFIX}gcc-intermediate:gcc-cross-intermediate"
PREFERRED_PROVIDERS += "virtual/${TARGET_PREFIX}gcc:gcc-cross"
PREFERRED_PROVIDERS += "virtual/${TARGET_PREFIX}g++:gcc-cross"

# gstreamer
GST_VERSION = "1.0"

# Force the older version of liberation-fonts until we fix the fontforge issue
PREFERRED_VERSION_liberation-fonts ?= "1.04"

PREFERRED_VERSION_netatalk ?= "2.2.3"

# enigma2 plugins
PREFERRED_PROVIDER_enigma2-plugin-extensions-advancedmovieselection = "enigma2-plugins"
PREFERRED_PROVIDER_enigma2-plugin-extensions-aihdcontroler = "enigma2-plugins"
PREFERRED_PROVIDER_enigma2-plugin-extensions-antiscrollbar = "enigma2-plugins"
PREFERRED_PROVIDER_enigma2-plugin-extensions-ardmediathek = "enigma2-plugins"
PREFERRED_PROVIDER_enigma2-plugin-extensions-audiorestart = "enigma2-plugins"
PREFERRED_PROVIDER_enigma2-plugin-extensions-audiosync = "enigma2-plugins"
PREFERRED_PROVIDER_enigma2-plugin-extensions-autotimer = "enigma2-plugins"
PREFERRED_PROVIDER_enigma2-plugin-extensions-babelzapper = "enigma2-plugins"
PREFERRED_PROVIDER_enigma2-plugin-extensions-birthdayreminder = "enigma2-plugins"
PREFERRED_PROVIDER_enigma2-plugin-extensions-bitrateviewer = "enigma2-plugins"
PREFERRED_PROVIDER_enigma2-plugin-extensions-bmediacenter = "enigma2-plugins"
PREFERRED_PROVIDER_enigma2-plugin-extensions-bonjour = "enigma2-plugins"
PREFERRED_PROVIDER_enigma2-plugin-extensions-cdinfo = "enigma2-plugins"
PREFERRED_PROVIDER_enigma2-plugin-extensions-curlytx = "enigma2-plugins"
PREFERRED_PROVIDER_enigma2-plugin-extensions-dreamexplorer = "enigma2-plugins"
PREFERRED_PROVIDER_enigma2-plugin-extensions-dreamirc = "enigma2-plugins"
PREFERRED_PROVIDER_enigma2-plugin-extensions-dvdbackup = "enigma2-plugins"
PREFERRED_PROVIDER_enigma2-plugin-extensions-dyndns = "enigma2-plugins"
PREFERRED_PROVIDER_enigma2-plugin-extensions-easyinfo = "enigma2-plugins"
PREFERRED_PROVIDER_enigma2-plugin-extensions-easymedia = "enigma2-plugins"
PREFERRED_PROVIDER_enigma2-plugin-extensions-ecasa = "enigma2-plugins"
PREFERRED_PROVIDER_enigma2-plugin-extensions-eibox = "enigma2-plugins"
PREFERRED_PROVIDER_enigma2-plugin-extensions-elektro = "enigma2-plugins"
PREFERRED_PROVIDER_enigma2-plugin-extensions-emailclient = "enigma2-plugins"
PREFERRED_PROVIDER_enigma2-plugin-extensions-emission = "enigma2-plugins"
PREFERRED_PROVIDER_enigma2-plugin-extensions-eparted = "enigma2-plugins"
PREFERRED_PROVIDER_enigma2-plugin-extensions-epgbackup = "enigma2-plugins"
PREFERRED_PROVIDER_enigma2-plugin-extensions-epgrefresh = "enigma2-plugins"
PREFERRED_PROVIDER_enigma2-plugin-extensions-epgsearch = "enigma2-plugins"
PREFERRED_PROVIDER_enigma2-plugin-extensions-esame = "enigma2-plugins"
PREFERRED_PROVIDER_enigma2-plugin-extensions-fancontrol2 = "enigma2-plugins"
PREFERRED_PROVIDER_enigma2-plugin-extensions-filebrowser = "enigma2-plugins"
PREFERRED_PROVIDER_enigma2-plugin-extensions-flashexpander = "enigma2-plugins"
PREFERRED_PROVIDER_enigma2-plugin-extensions-fritzcall = "enigma2-plugins"
PREFERRED_PROVIDER_enigma2-plugin-extensions-fstabeditor = "enigma2-plugins"
PREFERRED_PROVIDER_enigma2-plugin-extensions-ftpbrowser = "enigma2-plugins"
PREFERRED_PROVIDER_enigma2-plugin-extensions-googlemaps = "enigma2-plugins"
PREFERRED_PROVIDER_enigma2-plugin-extensions-growlee = "enigma2-plugins"
PREFERRED_PROVIDER_enigma2-plugin-extensions-httpproxy = "enigma2-plugins"
PREFERRED_PROVIDER_enigma2-plugin-extensions-imdb = "enigma2-plugins"
PREFERRED_PROVIDER_enigma2-plugin-extensions-infobartunerstate = "enigma2-plugins"
PREFERRED_PROVIDER_enigma2-plugin-extensions-kiddytimer = "enigma2-plugins"
PREFERRED_PROVIDER_enigma2-plugin-extensions-lastfm = "enigma2-plugins"
PREFERRED_PROVIDER_enigma2-plugin-extensions-letterbox = "enigma2-plugins"
PREFERRED_PROVIDER_enigma2-plugin-extensions-logomanager = "enigma2-plugins"
PREFERRED_PROVIDER_enigma2-plugin-extensions-mediadownloader = "enigma2-plugins"
PREFERRED_PROVIDER_enigma2-plugin-extensions-menusort = "enigma2-plugins"
PREFERRED_PROVIDER_enigma2-plugin-extensions-merlinepg = "enigma2-plugins"
PREFERRED_PROVIDER_enigma2-plugin-extensions-merlinepgcenter = "enigma2-plugins"
PREFERRED_PROVIDER_enigma2-plugin-extensions-merlinmusicplayer = "enigma2-plugins"
PREFERRED_PROVIDER_enigma2-plugin-extensions-meteoitalia = "enigma2-plugins"
PREFERRED_PROVIDER_enigma2-plugin-extensions-mosaic = "enigma2-plugins"
PREFERRED_PROVIDER_enigma2-plugin-extensions-moviecut = "enigma2-plugins"
PREFERRED_PROVIDER_enigma2-plugin-extensions-movieepg = "enigma2-plugins"
PREFERRED_PROVIDER_enigma2-plugin-extensions-movielistpreview = "enigma2-plugins"
PREFERRED_PROVIDER_enigma2-plugin-extensions-movieretitle = "enigma2-plugins"
PREFERRED_PROVIDER_enigma2-plugin-extensions-moviesearch = "enigma2-plugins"
PREFERRED_PROVIDER_enigma2-plugin-extensions-movieselectionquickbutton = "enigma2-plugins"
PREFERRED_PROVIDER_enigma2-plugin-extensions-movietagger = "enigma2-plugins"
PREFERRED_PROVIDER_enigma2-plugin-extensions-multirc = "enigma2-plugins"
PREFERRED_PROVIDER_enigma2-plugin-extensions-mytube = "enigma2-plugins"
PREFERRED_PROVIDER_enigma2-plugin-extensions-namezap = "enigma2-plugins"
PREFERRED_PROVIDER_enigma2-plugin-extensions-ncidclient = "enigma2-plugins"
PREFERRED_PROVIDER_enigma2-plugin-extensions-netcaster = "enigma2-plugins"
PREFERRED_PROVIDER_enigma2-plugin-extensions-ofdb = "enigma2-plugins"
PREFERRED_PROVIDER_enigma2-plugin-extensions-orfat = "enigma2-plugins"
PREFERRED_PROVIDER_enigma2-plugin-extensions-orfteletext = "enigma2-plugins"
PREFERRED_PROVIDER_enigma2-plugin-extensions-partnerbox = "enigma2-plugins"
PREFERRED_PROVIDER_enigma2-plugin-extensions-permanentclock = "enigma2-plugins"
PREFERRED_PROVIDER_enigma2-plugin-extensions-permanenttimeshift = "enigma2-plugins"
PREFERRED_PROVIDER_enigma2-plugin-extensions-pipzap = "enigma2-plugins"
PREFERRED_PROVIDER_enigma2-plugin-extensions-pluginhider = "enigma2-plugins"
PREFERRED_PROVIDER_enigma2-plugin-extensions-pluginsort = "enigma2-plugins"
PREFERRED_PROVIDER_enigma2-plugin-extensions-podcast = "enigma2-plugins"
PREFERRED_PROVIDER_enigma2-plugin-extensions-primetimemanager = "enigma2-plugins"
PREFERRED_PROVIDER_enigma2-plugin-extensions-pushservice = "enigma2-plugins"
PREFERRED_PROVIDER_enigma2-plugin-extensions-quickbutton = "enigma2-plugins"
PREFERRED_PROVIDER_enigma2-plugin-extensions-reconstructapsc = "enigma2-plugins"
PREFERRED_PROVIDER_enigma2-plugin-extensions-remotetimer = "enigma2-plugins"
PREFERRED_PROVIDER_enigma2-plugin-extensions-rsdownloader = "enigma2-plugins"
PREFERRED_PROVIDER_enigma2-plugin-extensions-satloader = "enigma2-plugins"
PREFERRED_PROVIDER_enigma2-plugin-extensions-schiffe = "enigma2-plugins"
PREFERRED_PROVIDER_enigma2-plugin-extensions-seekbar = "enigma2-plugins"
PREFERRED_PROVIDER_enigma2-plugin-extensions-serienfilm = "enigma2-plugins"
PREFERRED_PROVIDER_enigma2-plugin-extensions-seriesplugin = "enigma2-plugins"
PREFERRED_PROVIDER_enigma2-plugin-extensions-shoutcast = "enigma2-plugins"
PREFERRED_PROVIDER_enigma2-plugin-extensions-showclock = "enigma2-plugins"
PREFERRED_PROVIDER_enigma2-plugin-extensions-simplerss = "enigma2-plugins"
PREFERRED_PROVIDER_enigma2-plugin-extensions-startuptostandby = "enigma2-plugins"
PREFERRED_PROVIDER_enigma2-plugin-extensions-subsdownloader2 = "enigma2-plugins"
PREFERRED_PROVIDER_enigma2-plugin-extensions-sudoku = "enigma2-plugins"
PREFERRED_PROVIDER_enigma2-plugin-extensions-svdrp = "enigma2-plugins"
PREFERRED_PROVIDER_enigma2-plugin-extensions-tageditor = "enigma2-plugins"
PREFERRED_PROVIDER_enigma2-plugin-extensions-teletext = "enigma2-plugins"
PREFERRED_PROVIDER_enigma2-plugin-extensions-trafficinfo = "enigma2-plugins"
PREFERRED_PROVIDER_enigma2-plugin-extensions-transmission = "enigma2-plugins"
PREFERRED_PROVIDER_enigma2-plugin-extensions-tvcharts = "enigma2-plugins"
PREFERRED_PROVIDER_enigma2-plugin-extensions-unwetterinfo = "enigma2-plugins"
PREFERRED_PROVIDER_enigma2-plugin-extensions-valixdcontrol = "enigma2-plugins"
PREFERRED_PROVIDER_enigma2-plugin-extensions-vierg = "enigma2-plugins"
PREFERRED_PROVIDER_enigma2-plugin-extensions-virtualzap = "enigma2-plugins"
PREFERRED_PROVIDER_enigma2-plugin-extensions-vlcplayer = "enigma2-plugins"
PREFERRED_PROVIDER_enigma2-plugin-extensions-weatherplugin = "enigma2-plugins"
PREFERRED_PROVIDER_enigma2-plugin-extensions-webcamviewer = "enigma2-plugins"
PREFERRED_PROVIDER_enigma2-plugin-extensions-werbezapper = "enigma2-plugins"
PREFERRED_PROVIDER_enigma2-plugin-extensions-youtubeplayer = "enigma2-plugins"
PREFERRED_PROVIDER_enigma2-plugin-extensions-yttrailer = "enigma2-plugins"
PREFERRED_PROVIDER_enigma2-plugin-extensions-zaphistorybrowser = "enigma2-plugins"
PREFERRED_PROVIDER_enigma2-plugin-extensions-zapstatistic = "enigma2-plugins"
PREFERRED_PROVIDER_enigma2-plugin-extensions-zdfmediathek = "enigma2-plugins"
PREFERRED_PROVIDER_enigma2-plugin-systemplugins-3dsettings = "enigma2-plugins"
PREFERRED_PROVIDER_enigma2-plugin-systemplugins-advhdmi = "enigma2-plugins"
PREFERRED_PROVIDER_enigma2-plugin-systemplugins-aspectratioswitch = "enigma2-plugins"
PREFERRED_PROVIDER_enigma2-plugin-systemplugins-automaticcleanup = "enigma2-plugins"
PREFERRED_PROVIDER_enigma2-plugin-systemplugins-automatictimerlistcleanup = "enigma2-plugins"
PREFERRED_PROVIDER_enigma2-plugin-systemplugins-automaticvolumeadjustment = "enigma2-plugins"
PREFERRED_PROVIDER_enigma2-plugin-systemplugins-autoresolution = "enigma2-plugins"
PREFERRED_PROVIDER_enigma2-plugin-systemplugins-mphelp = "enigma2-plugins"
PREFERRED_PROVIDER_enigma2-plugin-systemplugins-networkbrowser = "enigma2-plugins"
PREFERRED_PROVIDER_enigma2-plugin-systemplugins-pipservicerelation = "enigma2-plugins"
PREFERRED_PROVIDER_enigma2-plugin-systemplugins-recordinfobar = "enigma2-plugins"
PREFERRED_PROVIDER_enigma2-plugin-systemplugins-setpasswd = "enigma2-plugins"
PREFERRED_PROVIDER_enigma2-plugin-systemplugins-startupservice = "enigma2-plugins"
PREFERRED_PROVIDER_enigma2-plugin-systemplugins-systemtime = "enigma2-plugins"
PREFERRED_PROVIDER_enigma2-plugin-systemplugins-vfdcontrol = "enigma2-plugins"
PREFERRED_PROVIDER_enigma2-plugin-systemplugins-videocolorspace = "enigma2-plugins"
PREFERRED_PROVIDER_enigma2-plugin-systemplugins-vps = "enigma2-plugins"

# alliance plugins
PREFERRED_PROVIDER_enigma2-plugin-extensions-btdevicesmanager = "enigma2-alliance-plugins"
PREFERRED_PROVIDER_enigma2-plugin-extensions-dlnabrowser = "enigma2-alliance-plugins"
PREFERRED_PROVIDER_enigma2-plugin-extensions-dlnaserver = "enigma2-alliance-plugins"
PREFERRED_PROVIDER_enigma2-plugin-extensions-fempa = "enigma2-alliance-plugins"
PREFERRED_PROVIDER_enigma2-plugin-extensions-gbipboxclient = "enigma2-alliance-plugins"
PREFERRED_PROVIDER_enigma2-plugin-extensions-lcd4linux = "enigma2-alliance-plugins"
PREFERRED_PROVIDER_enigma2-plugin-extensions-ondemand = "enigma2-alliance-plugins"
PREFERRED_PROVIDER_enigma2-plugin-extensions-rcuselect = "enigma2-alliance-plugins"
PREFERRED_PROVIDER_enigma2-plugin-extensions-rezap = "enigma2-alliance-plugins"
PREFERRED_PROVIDER_enigma2-plugin-extensions-streamtv = "enigma2-alliance-plugins"
PREFERRED_PROVIDER_enigma2-plugin-extensions-tunerserver = "enigma2-alliance-plugins"
PREFERRED_PROVIDER_enigma2-plugin-extensions-webbrowser = "enigma2-alliance-plugins"
PREFERRED_PROVIDER_enigma2-plugin-systemplugins-abmcustommiximporter = "enigma2-alliance-plugins"
PREFERRED_PROVIDER_enigma2-plugin-systemplugins-audioeffect = "enigma2-alliance-plugins"
PREFERRED_PROVIDER_enigma2-plugin-systemplugins-blindscan = "enigma2-alliance-plugins"
PREFERRED_PROVIDER_enigma2-plugin-systemplugins-channelsimporter = "enigma2-alliance-plugins"
PREFERRED_PROVIDER_enigma2-plugin-systemplugins-dmblindscan = "enigma2-alliance-plugins"
PREFERRED_PROVIDER_enigma2-plugin-systemplugins-ewvfdcontrol = "enigma2-alliance-plugins"
PREFERRED_PROVIDER_enigma2-plugin-systemplugins-f3ledcontrol = "enigma2-alliance-plugins"
PREFERRED_PROVIDER_enigma2-plugin-systemplugins-firmwareupgrade = "enigma2-alliance-plugins"
PREFERRED_PROVIDER_enigma2-plugin-systemplugins-fpgaupgrade = "enigma2-alliance-plugins"
PREFERRED_PROVIDER_enigma2-plugin-systemplugins-gigablueremote = "enigma2-alliance-plugins"
PREFERRED_PROVIDER_enigma2-plugin-systemplugins-gigabluevfdcontrol = "enigma2-alliance-plugins"
PREFERRED_PROVIDER_enigma2-plugin-systemplugins-inivfdcontrol = "enigma2-alliance-plugins"
PREFERRED_PROVIDER_enigma2-plugin-systemplugins-micomupgrade = "enigma2-alliance-plugins"
PREFERRED_PROVIDER_enigma2-plugin-systemplugins-misplslcnscan = "enigma2-alliance-plugins"
PREFERRED_PROVIDER_enigma2-plugin-systemplugins-multitranscodingsetup = "enigma2-alliance-plugins"
PREFERRED_PROVIDER_enigma2-plugin-systemplugins-odinm7vfdcontrol = "enigma2-alliance-plugins"
PREFERRED_PROVIDER_enigma2-plugin-systemplugins-remotecontrolcode = "enigma2-alliance-plugins"
PREFERRED_PROVIDER_enigma2-plugin-systemplugins-satipclient = "enigma2-alliance-plugins"
PREFERRED_PROVIDER_enigma2-plugin-systemplugins-sf8vfdcontrol = "enigma2-alliance-plugins"
PREFERRED_PROVIDER_enigma2-plugin-systemplugins-simplefancontrol = "enigma2-alliance-plugins"
PREFERRED_PROVIDER_enigma2-plugin-systemplugins-terrestrialscan = "enigma2-alliance-plugins"
PREFERRED_PROVIDER_enigma2-plugin-systemplugins-transcodingsetup = "enigma2-alliance-plugins"
PREFERRED_PROVIDER_enigma2-plugin-systemplugins-ventonfancontrol = "enigma2-alliance-plugins"
PREFERRED_PROVIDER_enigma2-plugin-systemplugins-vpledcontrol = "enigma2-alliance-plugins"
PREFERRED_PROVIDER_enigma2-plugin-systemplugins-vuduofancontrol = "enigma2-alliance-plugins"
PREFERRED_PROVIDER_enigma2-plugin-systemplugins-wirelessaccesspoint = "enigma2-alliance-plugins"
PREFERRED_PROVIDER_enigma2-plugin-systemplugins-xtrendfancontrol = "enigma2-alliance-plugins"
PREFERRED_PROVIDER_enigma2-plugin-systemplugins-xtrendremote = "enigma2-alliance-plugins"

# persianempire plugins
PREFERRED_PROVIDER_enigma2-plugin-extensions-airplayer = "enigma2-persianempire-plugins"
PREFERRED_PROVIDER_enigma2-plugin-extensions-blockcontent = "enigma2-persianempire-plugins"
PREFERRED_PROVIDER_enigma2-plugin-extensions-camrestart = "enigma2-persianempire-plugins"
PREFERRED_PROVIDER_enigma2-plugin-extensions-cccaminfo = "enigma2-persianempire-plugins"
PREFERRED_PROVIDER_enigma2-plugin-extensions-deviceinfo = "enigma2-persianempire-plugins"
PREFERRED_PROVIDER_enigma2-plugin-extensions-fontmagnifier = "enigma2-persianempire-plugins"
PREFERRED_PROVIDER_enigma2-plugin-extensions-localemanager = "enigma2-persianempire-plugins"
PREFERRED_PROVIDER_enigma2-plugin-extensions-navibarpe = "enigma2-persianempire-plugins"
PREFERRED_PROVIDER_enigma2-plugin-extensions-packagemanager = "enigma2-persianempire-plugins"
PREFERRED_PROVIDER_enigma2-plugin-extensions-pecammanager = "enigma2-persianempire-plugins"
PREFERRED_PROVIDER_enigma2-plugin-extensions-pefaq = "enigma2-persianempire-plugins"
PREFERRED_PROVIDER_enigma2-plugin-extensions-peinfo = "enigma2-persianempire-plugins"
PREFERRED_PROVIDER_enigma2-plugin-extensions-pespeedup = "enigma2-persianempire-plugins"
PREFERRED_PROVIDER_enigma2-plugin-extensions-peweather = "enigma2-persianempire-plugins"
PREFERRED_PROVIDER_enigma2-plugin-extensions-pureprestige = "enigma2-persianempire-plugins"
PREFERRED_PROVIDER_enigma2-plugin-extensions-quickweather = "enigma2-persianempire-plugins"
PREFERRED_PROVIDER_enigma2-plugin-extensions-softcamupdater = "enigma2-persianempire-plugins"
PREFERRED_PROVIDER_enigma2-plugin-extensions-vusolo2cihighbitratefix = "enigma2-persianempire-plugins"
PREFERRED_PROVIDER_enigma2-plugin-systemplugins-bouquetprotection = "enigma2-persianempire-plugins"
PREFERRED_PROVIDER_enigma2-plugin-systemplugins-networkserver = "enigma2-persianempire-plugins"
PREFERRED_PROVIDER_enigma2-plugin-systemplugins-pepanel = "enigma2-persianempire-plugins"
PREFERRED_PROVIDER_enigma2-plugin-systemplugins-sambaserver = "enigma2-persianempire-plugins"
PREFERRED_PROVIDER_enigma2-plugin-systemplugins-satelliteeditor = "enigma2-persianempire-plugins"
PREFERRED_PROVIDER_enigma2-plugin-systemplugins-serviceeditor = "enigma2-persianempire-plugins"
PREFERRED_PROVIDER_enigma2-plugin-systemplugins-simplesatscan = "enigma2-persianempire-plugins"

# 2boom plugins
PREFERRED_PROVIDER_enigma2-plugin-extensions-arbouquet = "enigma2-2boom-plugins"
PREFERRED_PROVIDER_enigma2-plugin-extensions-ecccam = "enigma2-2boom-plugins"
PREFERRED_PROVIDER_enigma2-plugin-extensions-epanel = "enigma2-2boom-plugins"
PREFERRED_PROVIDER_enigma2-plugin-extensions-epgdd = "enigma2-2boom-plugins"
PREFERRED_PROVIDER_enigma2-plugin-extensions-ipktools = "enigma2-2boom-plugins"
PREFERRED_PROVIDER_enigma2-plugin-extensions-ltv = "enigma2-2boom-plugins"
PREFERRED_PROVIDER_enigma2-plugin-extensions-m2b = "enigma2-2boom-plugins"
PREFERRED_PROVIDER_enigma2-plugin-extensions-qcifh = "enigma2-2boom-plugins"
PREFERRED_PROVIDER_enigma2-plugin-extensions-qeifh = "enigma2-2boom-plugins"
PREFERRED_PROVIDER_enigma2-plugin-extensions-qerfh = "enigma2-2boom-plugins"
PREFERRED_PROVIDER_enigma2-plugin-extensions-quickecminfo = "enigma2-2boom-plugins"
PREFERRED_PROVIDER_enigma2-plugin-extensions-quickemurestart = "enigma2-2boom-plugins"
PREFERRED_PROVIDER_enigma2-plugin-extensions-reloadsl = "enigma2-2boom-plugins"
PREFERRED_PROVIDER_enigma2-plugin-extensions-remountnetshare = "enigma2-2boom-plugins"
PREFERRED_PROVIDER_enigma2-plugin-extensions-rpulite = "enigma2-2boom-plugins"
PREFERRED_PROVIDER_enigma2-plugin-extensions-tpulite = "enigma2-2boom-plugins"
PREFERRED_PROVIDER_enigma2-plugin-extensions-updatepreview = "enigma2-2boom-plugins"
PREFERRED_PROVIDER_enigma2-plugin-extensions-yweather = "enigma2-2boom-plugins"
PREFERRED_PROVIDER_enigma2-plugin-extensions-ywfh = "enigma2-2boom-plugins"
```
